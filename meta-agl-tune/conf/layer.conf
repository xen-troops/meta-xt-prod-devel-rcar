## meta-agl-tune/conf/layer.conf
```bitbake
# We have a conf and classes directory, add to BBPATH
BBPATH .= ":${LAYERDIR}"

# We have a packages directory, add to BBFILES
BBFILES += "${LAYERDIR}/recipes-*/*/*.bb \
            ${LAYERDIR}/recipes-*/*/*.bbappend"

BBFILE_COLLECTIONS += "agl-tune"
BBFILE_PATTERN_agl-tune := "^${LAYERDIR}/"
# This layer should have higher priority than product
# to allow us override linux/defconfig
BBFILE_PRIORITY_agl-tune = "13"

LAYERSERIES_COMPAT_agl-tune = "dunfell"
```

## meta-aos-tune/conf/layer.conf
```bitbake
# We have a conf and classes directory, add to BBPATH
BBPATH .= ":${LAYERDIR}"

# We have a packages directory, add to BBFILES
BBFILES += "${LAYERDIR}/recipes-*/*/*.bb \
            ${LAYERDIR}/recipes-*/*/*.bbappend"

BBFILE_COLLECTIONS += "aos-tune"
BBFILE_PATTERN_aos-tune := "^${LAYERDIR}/"
BBFILE_PRIORITY_aos-tune = "12"

LAYERSERIES_COMPAT_aos-tune = "kirkstone"
```

## meta-xt-domx-gen3/conf/layer.conf
```bitbake
# We have a conf and classes directory, add to BBPATH
BBPATH .= ":${LAYERDIR}"

# We have a packages directory, add to BBFILES
BBFILES += "${LAYERDIR}/recipes-*/*/*.bb \
"

BBFILES_DYNAMIC += " \
virtualization-layer:${LAYERDIR}/recipes-extended/xen/*.bbappend \
"

BBFILE_COLLECTIONS += "xt-domx-gen3"
BBFILE_PATTERN_xt-domx-gen3 := "^${LAYERDIR}/"
BBFILE_PRIORITY_xt-domx-gen3 = "12"

LAYERSERIES_COMPAT_xt-domx-gen3 = "kirkstone"
```

## meta-xt-prod-devel-rcar/meta-xt-prod-devel-rcar-driver-domain/conf/layer.conf
```bitbake
# We have a conf and classes directory, add to BBPATH
BBPATH .= ":${LAYERDIR}"

# We have a packages directory, add to BBFILES
BBFILES += "${LAYERDIR}/recipes-*/*/*.bb \
            ${LAYERDIR}/recipes-*/*/*.bbappend"

BBFILE_COLLECTIONS += "xt-prod-devel-driver-domain"
BBFILE_PATTERN_xt-prod-devel-driver-domain := "^${LAYERDIR}/"
BBFILE_PRIORITY_xt-prod-devel-driver-domain = "12"

LAYERSERIES_COMPAT_xt-prod-devel-driver-domain = "kirkstone"
```
